#include "Arduino.h"
#include "SPI.h"

#define ST7735_CS  PB2
#define ST7735_RST PA8
#define ST7735_A0  PA6

#define BLACK                      0x0000
#define BLUE                       0x001F
#define RED                        0xF800
#define GREEN                      0x0400
#define CYAN                       0x07FF
#define MAGENTA                    0xF81F
#define YELLOW                     0xFFE0
#define WHITE                      0xFFFF
#define VIOLET                     0xEC1D
#define AQUA                       0x07FF
#define YELLOW_GREEN               0x9E66
#define PURPLE                     0x8010


const uint16_t scr_width  = 128;
const uint16_t scr_height = 128;
uint16_t OffSetX = 2;
uint16_t OffSetY = 1;


/*************************************************************************************************************
   Драйвер lcg 1.44" 128X128 ST7735 VER 1.0. на красной плате
 ************************************************************************************************************/
char const Font7x11[] =
{
  0x00, 0x00, 0x00, 0x00, 0x00, 0x00, 0x00, 0x00, 0x00, 0x00, 0x00,   // space 0x20  32
  0x08, 0x08, 0x08, 0x08, 0x08, 0x08, 0x08, 0x08, 0x00, 0x08, 0x08,   // ! 0x21  33
  0x12, 0x12, 0x12, 0x00, 0x00, 0x00, 0x00, 0x00, 0x00, 0x00, 0x00,   // " 0x22  34
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  0x7f, 0x7f, 0x7f, 0x7f, 0x7f, 0x7f, 0x7f, 0x7f, 0x7f, 0x7f, 0x7f
}; //  0x7F 127

#define HWRST_SET       digitalWrite(ST7735_RST,HIGH)
#define HWRST_RESET     digitalWrite(ST7735_RST,LOW)
#define ST7735_COMMAND  digitalWrite(ST7735_A0,LOW)
#define ST7735_DATA     digitalWrite(ST7735_A0,HIGH)
#define ST7735_SELECT   digitalWrite(ST7735_CS,LOW)
#define ST7735_UNSELECT digitalWrite(ST7735_CS,HIGH)

typedef enum
{
  scr_normal = 0,
  scr_CW     = 1,
  scr_CCW    = 2,
  scr_180    = 3
} ScrOrientation_TypeDef;


void ST7735_write(uint8_t data)
{
  ST7735_SELECT;
  SPI.transfer(data);
  ST7735_UNSELECT;
}

void ST7735_cmd(uint8_t cmd)
{
  ST7735_COMMAND;
  ST7735_write(cmd);
}

void ST7735_AddrSet(uint16_t XS, uint16_t YS, uint16_t XE, uint16_t YE)
{
  XS = XS + OffSetX;
  XE = XE + OffSetX;
  YS = YS + OffSetY;
  YE = YE + OffSetY;
  ST7735_cmd(0x2a);
  ST7735_DATA;
  ST7735_write(XS >> 8);
  ST7735_write(XS);
  ST7735_write(XE >> 8);
  ST7735_write(XE);
  ST7735_cmd(0x2b);
  ST7735_DATA;
  ST7735_write(YS >> 8);
  ST7735_write(YS);
  ST7735_write(YE >> 8);
  ST7735_write(YE);
  ST7735_cmd(0x2c);
}

void ST7735_PutChar7x11(uint16_t X, uint16_t Y, uint8_t chr, uint16_t color, uint16_t bgcolor)
{
  uint16_t i, j;
  uint8_t buffer[11];
  uint8_t CH = color >> 8;
  uint8_t CL = (uint8_t)color;
  uint8_t BCH = bgcolor >> 8;
  uint8_t BCL = (uint8_t)bgcolor;

  memcpy(buffer, &Font7x11[(chr - 32) * 11], 11);
  ST7735_AddrSet(X, Y, X + 7, Y + 11);
  ST7735_DATA;
  for (i = 0; i < 11; i++)
  {
    for (j = 0; j < 7; j++)
    {
      if ((buffer[i] >> j) & 0x01)
      {
        ST7735_write(CH);
        ST7735_write(CL);
      }
      else
      {
        ST7735_write(BCH);
        ST7735_write(BCL);
      }
    }
    ST7735_write(BCH);
    ST7735_write(BCL);
  }
  for (i = 0; i < 8; i++)
  {
    ST7735_write(BCH);
    ST7735_write(BCL);
  }
}

void ST7735_PutStr7x11(uint8_t X, uint8_t Y, char *str, uint16_t color, uint16_t bgcolor)
{
  while (*str)
  {
    ST7735_PutChar7x11(X, Y, *str++, color, bgcolor);
    if (X < scr_width - 8) {
      X += 8;
    } else if (Y < scr_height - 12) {
      X = 0;
      Y += 12;
    } else {
      X = 0;
      Y = 0;
    }
  };
}

void ST7735_Clear(uint16_t color)
{
  uint16_t i;
  uint8_t  CH, CL;

  CH = color >> 8;
  CL = (uint8_t)color;

  ST7735_AddrSet(0, 0, (scr_width - 1), (scr_height - 1));
  ST7735_DATA;
  for (i = 0; i < (scr_width * scr_height); i++) {
    ST7735_write(CH);
    ST7735_write(CL);
  }
}


void ST7735_HWRST()
{
  HWRST_RESET;
  HWRST_SET;
}

void ST7735_data(uint8_t data)
{
  ST7735_DATA;
  ST7735_write(data);
}

void ST7735_SWRST()
{
  ST7735_cmd(0x01);
  ST7735_data(0x01);
}

void ST7735_Pixel(uint16_t X, uint16_t Y, uint16_t color)
{
  ST7735_AddrSet(X, Y, X, Y);
  ST7735_DATA;
  ST7735_write(color >> 8);
  ST7735_write((uint8_t)color);
}

void ST7735_HLine(uint16_t X1, uint16_t X2, uint16_t Y, uint16_t color)
{
  uint16_t i;
  uint8_t CH = color >> 8;
  uint8_t CL = (uint8_t)color;

  ST7735_AddrSet(X1, Y, X2, Y);
  ST7735_DATA;
  for (i = 0; i <= (X2 - X1); i++)
  {
    ST7735_write(CH);
    ST7735_write(CL);
  }
}

void ST7735_VLine(uint16_t X, uint16_t Y1, uint16_t Y2, uint16_t color)
{
  uint16_t i;
  uint8_t CH = color >> 8;
  uint8_t CL = (uint8_t)color;

  ST7735_AddrSet(X, Y1, X, Y2);
  ST7735_DATA;
  for (i = 0; i <= (Y2 - Y1); i++)
  {
    ST7735_write(CH);
    ST7735_write(CL);
  }
}

void ST7735_Line(int16_t X1, int16_t Y1, int16_t X2, int16_t Y2, uint16_t color)
{
  int16_t dX = X2 - X1;
  int16_t dY = Y2 - Y1;
  int16_t dXsym = (dX > 0) ? 1 : -1;
  int16_t dYsym = (dY > 0) ? 1 : -1;

  if (dX == 0)
  {
    if (Y2 > Y1) ST7735_VLine(X1, Y1, Y2, color); else ST7735_VLine(X1, Y2, Y1, color);
    return;
  }
  if (dY == 0)
  {
    if (X2 > X1) ST7735_HLine(X1, X2, Y1, color); else ST7735_HLine(X2, X1, Y1, color);
    return;
  }

  dX *= dXsym;
  dY *= dYsym;
  int16_t dX2 = dX << 1;
  int16_t dY2 = dY << 1;
  int16_t di;

  if (dX >= dY)
  {
    di = dY2 - dX;
    while (X1 != X2)
    {
      ST7735_Pixel(X1, Y1, color);
      X1 += dXsym;
      if (di < 0)
      {
        di += dY2;
      }
      else
      {
        di += dY2 - dX2;
        Y1 += dYsym;
      }
    }
  }
  else
  {
    di = dX2 - dY;
    while (Y1 != Y2)
    {
      ST7735_Pixel(X1, Y1, color);
      Y1 += dYsym;
      if (di < 0)
      {
        di += dX2;
      }
      else
      {
        di += dX2 - dY2;
        X1 += dXsym;
      }
    }
  }
  ST7735_Pixel(X1, Y1, color);
}

void ST7735_Rect(uint16_t X1, uint16_t Y1, uint16_t X2, uint16_t Y2, uint16_t color)
{
  ST7735_HLine(X1, X2, Y1, color);
  ST7735_HLine(X1, X2, Y2, color);
  ST7735_VLine(X1, Y1, Y2, color);
  ST7735_VLine(X2, Y1, Y2, color);
}

void ST7735_FillRect(uint16_t X1, uint16_t Y1, uint16_t X2, uint16_t Y2, uint16_t color)
{
  uint16_t i;
  uint16_t FS = (X2 - X1 + 1) * (Y2 - Y1 + 1);
  uint8_t CH = color >> 8;
  uint8_t CL = (uint8_t)color;

  ST7735_AddrSet(X1, Y1, X2, Y2);
  ST7735_DATA;
  for (i = 0; i < FS; i++)
  {
    ST7735_write(CH);
    ST7735_write(CL);
  }
}

void ST7735_init() {
  ST7735_HWRST();
  delay(15);
  ST7735_SWRST();
  delay(150);
  ST7735_cmd(0x11); //SLPOUT
  delay(255);
  ST7735_cmd(0xb1); //FRMCTR1
  ST7735_DATA;
  ST7735_write(0x01);
  ST7735_write(0x2c);
  ST7735_write(0x2d);
  ST7735_cmd(0xb2); //FRMCTR2
  ST7735_DATA;
  ST7735_write(0x01);
  ST7735_write(0x2c);
  ST7735_write(0x2d);
  ST7735_cmd(0xb3); //FRMCTR3
  ST7735_DATA;
  ST7735_write(0x01);
  ST7735_write(0x2c);
  ST7735_write(0x2d);
  ST7735_write(0x01);
  ST7735_write(0x2c);
  ST7735_write(0x2d);
  ST7735_cmd(0xb4); //INVCTR
  ST7735_data(0x07);
  ST7735_cmd(0xc0); //PWCTR1
  ST7735_DATA;
  ST7735_write(0xa2);
  ST7735_write(0x02);
  ST7735_write(0x84);
  ST7735_cmd(0xc1); //PWCTR2
  ST7735_data(0xc5);
  ST7735_cmd(0xC2); //PWCTR3
  ST7735_DATA;
  ST7735_write(0x0a);
  ST7735_write(0x00);
  ST7735_cmd(0xc3); //PWCTR4
  ST7735_DATA;
  ST7735_write(0x8a);
  ST7735_write(0x2a);
  ST7735_cmd(0xc4); //PWCTR5
  ST7735_DATA;
  ST7735_write(0x8a);
  ST7735_write(0xee);
  ST7735_cmd(0xc5); //VMCTR1
  ST7735_data(0x0e);
  ST7735_cmd(0x20); //INVOFF
  ST7735_cmd(0x36); //MADCTL
  ST7735_data(0x8);
  ST7735_cmd(0x3a); //COLMOD
  ST7735_data(0x05);
  delay(10);
  ST7735_cmd(0x2a); //CASET
  ST7735_DATA;
  ST7735_write(0x00);
  ST7735_write(0x00);
  ST7735_write(0x00);
  ST7735_write(0x7f);
  ST7735_cmd(0x2b); //RASET
  ST7735_DATA;
  ST7735_write(0x00);
  ST7735_write(0x00);
  ST7735_write(0x00);
  ST7735_write(0x7f);
  ST7735_cmd(0xe0); //GMCTRP1
  ST7735_DATA;
  ST7735_write(0x02);
  ST7735_write(0x1c);
  ST7735_write(0x07);
  ST7735_write(0x12);
  ST7735_write(0x37);
  ST7735_write(0x32);
  ST7735_write(0x29);
  ST7735_write(0x2d);
  ST7735_write(0x29);
  ST7735_write(0x25);
  ST7735_write(0x28);
  ST7735_write(0x39);
  ST7735_write(0x00);
  ST7735_write(0x01);
  ST7735_write(0x03);
  ST7735_write(0x10);
  ST7735_cmd(0xe1); //GMCTRN1
  ST7735_DATA;
  ST7735_write(0x03);
  ST7735_write(0x1d);
  ST7735_write(0x07);
  ST7735_write(0x06);
  ST7735_write(0x2e);
  ST7735_write(0x2c);
  ST7735_write(0x29);
  ST7735_write(0x2d);
  ST7735_write(0x2e);
  ST7735_write(0x2e);
  ST7735_write(0x37);
  ST7735_write(0x3f);
  ST7735_write(0x00);
  ST7735_write(0x00);
  ST7735_write(0x02);
  ST7735_write(0x10);
  ST7735_cmd(0x13); //NORON
  delay(10);
  ST7735_cmd(0x29); //DISPON
}

void ST7735_Orientation(ScrOrientation_TypeDef orientation)
{
  ST7735_cmd(0x36); // Memory data access control:
  switch (orientation)
  {
    case scr_CW:
      OffSetX = 3;
      OffSetY = 2;
      ST7735_data(0xa8);
      break;
    case scr_CCW:
      OffSetX = 1;
      OffSetY = 2;
      ST7735_data(0x68);
      break;
    case scr_180:
      OffSetX = 2;
      OffSetY = 3;
      ST7735_data(0xc8);
      break;
    default:
      OffSetX = 2;
      OffSetY = 1;
      ST7735_data(0x08);
      break;
  }
}
void ST7735_invertDisplay(bool i) {
  ST7735_cmd(i ? 0x21 : 0x20);
}

void setup() {
  
  pinMode(ST7735_RST, OUTPUT);
  pinMode(ST7735_CS, OUTPUT);
  pinMode(ST7735_A0, OUTPUT);

  SPI.beginTransaction(SPISettings(20000000)); // Запускаем SPI на частоте 20 Мгц

  ST7735_init();
  ST7735_Orientation(scr_normal);
  ST7735_Clear(BLACK);
  ST7735_Rect(0, 6, 127, 127, YELLOW);
  ST7735_PutStr7x11(35, 0,  (char *)"[ MODE ]", YELLOW, BLACK);
  ST7735_PutStr7x11(45, 30, (char *)"SWEEP", YELLOW, BLACK);
  ST7735_PutStr7x11(45, 50, (char *)"R6DCZ", YELLOW, BLACK);
  ST7735_PutStr7x11(45, 70, (char *)"KVN234", YELLOW, BLACK);
  ST7735_PutStr7x11(45, 90, (char *)"GEN", YELLOW, BLACK);
  
}

void loop() {
  
}